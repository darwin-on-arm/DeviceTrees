/*
 * USB armory MkI devicetree
 *
 * Based on the Linux one.
 */

#include "Skeleton.dtsi"
#include "iMX53.dtsi"

/ {
    compatible = "inversepath,imx53-usbarmory", "fsl,imx53", "AppleARM";
    model = "Inverse Path USB armory MkI";

    /*
     * SDRAM allocation.
     */
    memory {
        device_type = "memory";
        reg = <0x70000000 0x20000000>; /* 512 MB */
    };
};

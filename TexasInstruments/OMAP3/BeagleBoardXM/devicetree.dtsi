/*
 * BeagleBoard Device Tree.
 *
 * Based on the Linux one.
 */

#include "Skeleton.dtsi"
#include "OMAP3.dtsi"

/ {
    compatible = "N88AP", "ti,beagle-xm", "ti,dm3730", "ti-omap3", "AppleARM";
    model = "Texas Instruments BeagleBoard xM";

    /*
     * SDRAM allocation.
     */
    memory {
        device_type = "memory";
        reg = <0x80000000 0x20000000>; /* 512 MB */
    };
};